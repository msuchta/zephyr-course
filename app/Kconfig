## app/Kconfig
```kconfig
menu "App settings"

config APP_HEARTBEAT_PERIOD_MS
    int "Led blinking period in miliseconds"
    default 500
    range 100 2000

endmenu

source "Kconfig.zephyr"
```

## boards/my_board/board.yml
```yaml
board:
  name: my_board
  full_name: My Board for Iomico course
  vendor: M_Suchta
  socs:
    - name: stm32f446xx
```

## boards/my_board_from_scratch/board.yml
```yaml
board:
  name: my_board_from_scratch
  full_name: My Board from scratch for Iomico course
  vendor: M_Suchta
  socs:
    - name: stm32f446xx
```

## boards/my_board_from_scratch/my_board_from_scratch_defconfig
```kconfig
# enable GPIO
CONFIG_GPIO=y

CONFIG_SERIAL=y

# console
CONFIG_CONSOLE=y
CONFIG_UART_CONSOLE=y
```
